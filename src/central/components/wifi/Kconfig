## src/central/components/wifi/Kconfig
```kconfig
menu "central-config"
    config WIFI_SSID
        string "WiFi SSID"
        help
            SSID (network name) for the example to connect to.

    config WIFI_PASS
        string "WiFi Password"
        help
            WiFi password (WPA or WPA2) for the example to use.
endmenu
```

## src/peripheral/components/ble/Kconfig
```kconfig
config SLEEP_TIME
    int "Time to sleep (in minutes)"
    range 1 1440
    default 240
    help
        When BLE advertising is finished (sucessfully or not) the ESP32 will sleep.
        This configuration determines for how long in minutes.

config DEVICE_NAME
    string "BLE device name"
    default "ble_sensor"
```
